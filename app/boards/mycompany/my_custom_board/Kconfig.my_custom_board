## app/boards/mycompany/my_custom_board/Kconfig.my_custom_board
```kconfig
# Copyright (c) 2020 Intel Corporation
# SPDX-License-Identifier: Apache-2.0

config BOARD_MY_CUSTOM_BOARD
	bool "My Custom Board"
	select SOC_STM32F407XE
```

## app/boards/mycompany/my_custom_board/board.yml
```yaml
board:
  name: my_custom_board
  full_name: My Custom Black STM32 F407VE Development Board
  vendor: mycompany
  socs:
    - name: stm32f407xx
```

## app/boards/mycompany/my_custom_board/my_custom_board_stm32f407xx_defconfig
```kconfig
# SPDX-License-Identifier: Apache-2.0

# Enable MPU
CONFIG_ARM_MPU=y

CONFIG_BOARD_MY_CUSTOM_BOARD=y


# Enable HW stack protection
CONFIG_HW_STACK_PROTECTION=y

# Enable UART
CONFIG_SERIAL=y

# Console
CONFIG_CONSOLE=y
CONFIG_UART_CONSOLE=y

# Enable GPIO
CONFIG_GPIO=y
```

## app/boards/mycompany/our_board/Kconfig.our_board
```kconfig
# Copyright (c) 2020 Intel Corporation
# SPDX-License-Identifier: Apache-2.0

config BOARD_OUR_BOARD
	bool "Our Board"
	select SOC_STM32F407XE
```

## app/boards/mycompany/our_board/board.yml
```yaml
board:
  name: our_board
  full_name: Our Custom Black STM32 F407VE Development Board
  vendor: mycompany
  socs:
    - name: stm32f407xx
```

## app/drivers/our_led_sensor/Kconfig
```kconfig
config OUR_LED_SENSOR
    bool "Custom LED Sensor Driver"
    default y
    select GPIO
    help
      Enable the custom sensor driver that controls an on-board LED.
```

## twister-out.3/qemu_x86_atom/zephyr_gnu/zephyr-course/tests/ring_buf/homework.unit.ring_buf/Kconfig/arch/Kconfig.tmp
```kconfig
# Load Zephyr Arch Kconfig descriptions.
osource "E:/zephyr-projects/zephyr-projects/zephyrproject/deps/zephyr/arch/rx/Kconfig"
osource "E:/zephyr-projects/zephyr-projects/zephyrproject/deps/zephyr/arch/x86/Kconfig"
osource "E:/zephyr-projects/zephyr-projects/zephyrproject/deps/zephyr/arch/xtensa/Kconfig"
osource "E:/zephyr-projects/zephyr-projects/zephyrproject/deps/zephyr/arch/sparc/Kconfig"
osource "E:/zephyr-projects/zephyr-projects/zephyrproject/deps/zephyr/arch/riscv/Kconfig"
osource "E:/zephyr-projects/zephyr-projects/zephyrproject/deps/zephyr/arch/posix/Kconfig"
osource "E:/zephyr-projects/zephyr-projects/zephyrproject/deps/zephyr/arch/openrisc/Kconfig"
osource "E:/zephyr-projects/zephyr-projects/zephyrproject/deps/zephyr/arch/mips/Kconfig"
osource "E:/zephyr-projects/zephyr-projects/zephyrproject/deps/zephyr/arch/arm64/Kconfig"
osource "E:/zephyr-projects/zephyr-projects/zephyrproject/deps/zephyr/arch/arm/Kconfig"
osource "E:/zephyr-projects/zephyr-projects/zephyrproject/deps/zephyr/arch/arc/Kconfig"
```

## twister-out.3/qemu_x86_atom/zephyr_gnu/zephyr-course/tests/ring_buf/homework.unit.ring_buf/Kconfig/boards/Kconfig
```kconfig
# Load Zephyr board Kconfig descriptions.
osource "E:/zephyr-projects/zephyr-projects/zephyrproject/deps/zephyr/boards/qemu/x86/Kconfig"
```

## twister-out.3/qemu_x86_atom/zephyr_gnu/zephyr-course/tests/ring_buf/homework.unit.ring_buf/Kconfig/boards/Kconfig.defconfig.tmp
```kconfig
# Load Zephyr board defconfig descriptions.
osource "E:/zephyr-projects/zephyr-projects/zephyrproject/deps/zephyr/boards/qemu/x86/Kconfig.defconfig"
```

## twister-out.3/qemu_x86_atom/zephyr_gnu/zephyr-course/tests/ring_buf/homework.unit.ring_buf/Kconfig/soc/Kconfig
```kconfig
# Load Zephyr SoC Kconfig descriptions.
osource "E:/zephyr-projects/zephyr-projects/zephyrproject/deps/zephyr/soc/xlnx/zynqmp/Kconfig"
osource "E:/zephyr-projects/zephyr-projects/zephyrproject/deps/zephyr/soc/xlnx/zynq7000/Kconfig"
osource "E:/zephyr-projects/zephyr-projects/zephyrproject/deps/zephyr/soc/xlnx/versalnet/Kconfig"
osource "E:/zephyr-projects/zephyr-projects/zephyrproject/deps/zephyr/soc/xlnx/versal2/Kconfig"
osource "E:/zephyr-projects/zephyr-projects/zephyrproject/deps/zephyr/soc/xlnx/versal/Kconfig"
osource "E:/zephyr-projects/zephyr-projects/zephyrproject/deps/zephyr/soc/xen/Kconfig"
osource "E:/zephyr-projects/zephyr-projects/zephyrproject/deps/zephyr/soc/wch/ch32v/Kconfig"
osource "E:/zephyr-projects/zephyr-projects/zephyrproject/deps/zephyr/soc/ti/simplelink/Kconfig"
osource "E:/zephyr-projects/zephyr-projects/zephyrproject/deps/zephyr/soc/ti/mspm0/Kconfig"
osource "E:/zephyr-projects/zephyr-projects/zephyrproject/deps/zephyr/soc/ti/lm3s6965/Kconfig"
osource "E:/zephyr-projects/zephyr-projects/zephyrproject/deps/zephyr/soc/ti/k3/Kconfig"
osource "E:/zephyr-projects/zephyr-projects/zephyrproject/deps/zephyr/soc/telink/tlsr/Kconfig"
osource "E:/zephyr-projects/zephyr-projects/zephyrproject/deps/zephyr/soc/syna/sr100/Kconfig"
osource "E:/zephyr-projects/zephyr-projects/zephyrproject/deps/zephyr/soc/starfive/jh71xx/Kconfig"
osource "E:/zephyr-projects/zephyr-projects/zephyrproject/deps/zephyr/soc/st/stm32/Kconfig"
osource "E:/zephyr-projects/zephyr-projects/zephyrproject/deps/zephyr/soc/snps/qemu_arc/Kconfig"
osource "E:/zephyr-projects/zephyr-projects/zephyrproject/deps/zephyr/soc/snps/nsim/arc_v/Kconfig"
osource "E:/zephyr-projects/zephyr-projects/zephyrproject/deps/zephyr/soc/snps/nsim/arc_classic/Kconfig"
osource "E:/zephyr-projects/zephyr-projects/zephyrproject/deps/zephyr/soc/snps/hsdk4xd/Kconfig"
osource "E:/zephyr-projects/zephyr-projects/zephyrproject/deps/zephyr/soc/snps/hsdk/Kconfig"
osource "E:/zephyr-projects/zephyr-projects/zephyrproject/deps/zephyr/soc/snps/emsk/Kconfig"
osource "E:/zephyr-projects/zephyr-projects/zephyrproject/deps/zephyr/soc/snps/emsdp/Kconfig"
osource "E:/zephyr-projects/zephyr-projects/zephyrproject/deps/zephyr/soc/snps/arc_iot/Kconfig"
osource "E:/zephyr-projects/zephyr-projects/zephyrproject/deps/zephyr/soc/silabs/Kconfig"
osource "E:/zephyr-projects/zephyr-projects/zephyrproject/deps/zephyr/soc/sifli/sf32/Kconfig"
osource "E:/zephyr-projects/zephyr-projects/zephyrproject/deps/zephyr/soc/sifive/sifive_freedom/Kconfig"
osource "E:/zephyr-projects/zephyr-projects/zephyrproject/deps/zephyr/soc/sensry/Kconfig"
osource "E:/zephyr-projects/zephyr-projects/zephyrproject/deps/zephyr/soc/rockchip/Kconfig"
osource "E:/zephyr-projects/zephyr-projects/zephyrproject/deps/zephyr/soc/renode/riscv_virtual/Kconfig"
osource "E:/zephyr-projects/zephyr-projects/zephyrproject/deps/zephyr/soc/renode/cortex_r8_virtual/Kconfig"
osource "E:/zephyr-projects/zephyr-projects/zephyrproject/deps/zephyr/soc/renesas/smartbond/Kconfig"
osource "E:/zephyr-projects/zephyr-projects/zephyrproject/deps/zephyr/soc/renesas/rz/Kconfig"
osource "E:/zephyr-projects/zephyr-projects/zephyrproject/deps/zephyr/soc/renesas/rx/Kconfig"
osource "E:/zephyr-projects/zephyr-projects/zephyrproject/deps/zephyr/soc/renesas/rcar/Kconfig"
osource "E:/zephyr-projects/zephyr-projects/zephyrproject/deps/zephyr/soc/renesas/ra/Kconfig"
osource "E:/zephyr-projects/zephyr-projects/zephyrproject/deps/zephyr/soc/realtek/fingerprint/Kconfig"
osource "E:/zephyr-projects/zephyr-projects/zephyrproject/deps/zephyr/soc/realtek/ec/Kconfig"
osource "E:/zephyr-projects/zephyr-projects/zephyrproject/deps/zephyr/soc/realtek/bee/Kconfig"
osource "E:/zephyr-projects/zephyr-projects/zephyrproject/deps/zephyr/soc/realtek/ameba/Kconfig"
osource "E:/zephyr-projects/zephyr-projects/zephyrproject/deps/zephyr/soc/raspberrypi/rpi_pico/Kconfig"
osource "E:/zephyr-projects/zephyr-projects/zephyrproject/deps/zephyr/soc/quicklogic/eos_s3/Kconfig"
osource "E:/zephyr-projects/zephyr-projects/zephyrproject/deps/zephyr/soc/qemu/virt_riscv/Kconfig"
osource "E:/zephyr-projects/zephyr-projects/zephyrproject/deps/zephyr/soc/qemu/or1k/Kconfig"
osource "E:/zephyr-projects/zephyr-projects/zephyrproject/deps/zephyr/soc/qemu/malta/Kconfig"
osource "E:/zephyr-projects/zephyr-projects/zephyrproject/deps/zephyr/soc/openisa/rv32m1/Kconfig"
osource "E:/zephyr-projects/zephyr-projects/zephyrproject/deps/zephyr/soc/openhwgroup/cva6/Kconfig"
osource "E:/zephyr-projects/zephyr-projects/zephyrproject/deps/zephyr/soc/oct/osd32mp15x/Kconfig"
osource "E:/zephyr-projects/zephyr-projects/zephyrproject/deps/zephyr/soc/nxp/s32/Kconfig"
osource "E:/zephyr-projects/zephyr-projects/zephyrproject/deps/zephyr/soc/nxp/rw/Kconfig"
osource "E:/zephyr-projects/zephyr-projects/zephyrproject/deps/zephyr/soc/nxp/mcx/Kconfig"
osource "E:/zephyr-projects/zephyr-projects/zephyrproject/deps/zephyr/soc/nxp/lpc/Kconfig"
osource "E:/zephyr-projects/zephyr-projects/zephyrproject/deps/zephyr/soc/nxp/layerscape/Kconfig"
osource "E:/zephyr-projects/zephyr-projects/zephyrproject/deps/zephyr/soc/nxp/kinetis/Kconfig"
osource "E:/zephyr-projects/zephyr-projects/zephyrproject/deps/zephyr/soc/nxp/imxrt/Kconfig"
osource "E:/zephyr-projects/zephyr-projects/zephyrproject/deps/zephyr/soc/nxp/imx/Kconfig"
osource "E:/zephyr-projects/zephyr-projects/zephyrproject/deps/zephyr/soc/nuvoton/numicro/Kconfig"
osource "E:/zephyr-projects/zephyr-projects/zephyrproject/deps/zephyr/soc/nuvoton/numaker/Kconfig"
osource "E:/zephyr-projects/zephyr-projects/zephyrproject/deps/zephyr/soc/nuvoton/npcx/Kconfig"
osource "E:/zephyr-projects/zephyr-projects/zephyrproject/deps/zephyr/soc/nuvoton/npcm/Kconfig"
osource "E:/zephyr-projects/zephyr-projects/zephyrproject/deps/zephyr/soc/nordic/Kconfig"
osource "E:/zephyr-projects/zephyr-projects/zephyrproject/deps/zephyr/soc/neorv32/Kconfig"
osource "E:/zephyr-projects/zephyr-projects/zephyrproject/deps/zephyr/soc/native/inf_clock/Kconfig"
osource "E:/zephyr-projects/zephyr-projects/zephyrproject/deps/zephyr/soc/microchip/sam/sama7/Kconfig"
osource "E:/zephyr-projects/zephyr-projects/zephyrproject/deps/zephyr/soc/microchip/sam/sam_d5x_e5x/Kconfig"
osource "E:/zephyr-projects/zephyr-projects/zephyrproject/deps/zephyr/soc/microchip/pic64/Kconfig"
osource "E:/zephyr-projects/zephyr-projects/zephyrproject/deps/zephyr/soc/microchip/pic32c/pic32cz_ca/Kconfig"
osource "E:/zephyr-projects/zephyr-projects/zephyrproject/deps/zephyr/soc/microchip/pic32c/pic32cx_sg/Kconfig"
osource "E:/zephyr-projects/zephyr-projects/zephyrproject/deps/zephyr/soc/microchip/pic32c/pic32cm_pl/Kconfig"
osource "E:/zephyr-projects/zephyr-projects/zephyrproject/deps/zephyr/soc/microchip/pic32c/pic32cm_jh/Kconfig"
osource "E:/zephyr-projects/zephyr-projects/zephyrproject/deps/zephyr/soc/microchip/miv/Kconfig"
osource "E:/zephyr-projects/zephyr-projects/zephyrproject/deps/zephyr/soc/microchip/mec/Kconfig"
osource "E:/zephyr-projects/zephyr-projects/zephyrproject/deps/zephyr/soc/mediatek/mt8xxx/Kconfig"
osource "E:/zephyr-projects/zephyr-projects/zephyrproject/deps/zephyr/soc/lowrisc/opentitan/Kconfig"
osource "E:/zephyr-projects/zephyr-projects/zephyrproject/deps/zephyr/soc/litex/litex_vexriscv/Kconfig"
osource "E:/zephyr-projects/zephyr-projects/zephyrproject/deps/zephyr/soc/ite/ec/Kconfig"
osource "E:/zephyr-projects/zephyr-projects/zephyrproject/deps/zephyr/soc/intel/wildcat_lake/Kconfig"
osource "E:/zephyr-projects/zephyr-projects/zephyrproject/deps/zephyr/soc/intel/raptor_lake/Kconfig"
osource "E:/zephyr-projects/zephyr-projects/zephyrproject/deps/zephyr/soc/intel/panther_lake/Kconfig"
osource "E:/zephyr-projects/zephyr-projects/zephyrproject/deps/zephyr/soc/intel/lakemont/Kconfig"
osource "E:/zephyr-projects/zephyr-projects/zephyrproject/deps/zephyr/soc/intel/intel_socfpga_std/Kconfig"
osource "E:/zephyr-projects/zephyr-projects/zephyrproject/deps/zephyr/soc/intel/intel_socfpga/Kconfig"
osource "E:/zephyr-projects/zephyr-projects/zephyrproject/deps/zephyr/soc/intel/intel_niosv/Kconfig"
osource "E:/zephyr-projects/zephyr-projects/zephyrproject/deps/zephyr/soc/intel/intel_ish/Kconfig"
osource "E:/zephyr-projects/zephyr-projects/zephyrproject/deps/zephyr/soc/intel/intel_adsp/Kconfig"
osource "E:/zephyr-projects/zephyr-projects/zephyrproject/deps/zephyr/soc/intel/elkhart_lake/Kconfig"
osource "E:/zephyr-projects/zephyr-projects/zephyrproject/deps/zephyr/soc/intel/atom/Kconfig"
osource "E:/zephyr-projects/zephyr-projects/zephyrproject/deps/zephyr/soc/intel/apollo_lake/Kconfig"
osource "E:/zephyr-projects/zephyr-projects/zephyrproject/deps/zephyr/soc/intel/alder_lake/Kconfig"
osource "E:/zephyr-projects/zephyr-projects/zephyrproject/deps/zephyr/soc/infineon/psoc4/Kconfig"
osource "E:/zephyr-projects/zephyr-projects/zephyrproject/deps/zephyr/soc/infineon/edge/Kconfig"
osource "E:/zephyr-projects/zephyr-projects/zephyrproject/deps/zephyr/soc/infineon/cat3/Kconfig"
osource "E:/zephyr-projects/zephyr-projects/zephyrproject/deps/zephyr/soc/infineon/cat1c/Kconfig"
osource "E:/zephyr-projects/zephyr-projects/zephyrproject/deps/zephyr/soc/infineon/cat1b/Kconfig"
osource "E:/zephyr-projects/zephyr-projects/zephyrproject/deps/zephyr/soc/infineon/cat1a/Kconfig"
osource "E:/zephyr-projects/zephyr-projects/zephyrproject/deps/zephyr/soc/gd/gd32/Kconfig"
osource "E:/zephyr-projects/zephyr-projects/zephyrproject/deps/zephyr/soc/gaisler/leon3/Kconfig"
osource "E:/zephyr-projects/zephyr-projects/zephyrproject/deps/zephyr/soc/gaisler/gr716a/Kconfig"
osource "E:/zephyr-projects/zephyr-projects/zephyrproject/deps/zephyr/soc/focaltech/Kconfig"
osource "E:/zephyr-projects/zephyr-projects/zephyrproject/deps/zephyr/soc/espressif/Kconfig"
osource "E:/zephyr-projects/zephyr-projects/zephyrproject/deps/zephyr/soc/ene/kb1200/Kconfig"
osource "E:/zephyr-projects/zephyr-projects/zephyrproject/deps/zephyr/soc/ene/kb106x/Kconfig"
osource "E:/zephyr-projects/zephyr-projects/zephyrproject/deps/zephyr/soc/elan/em32f967/Kconfig"
osource "E:/zephyr-projects/zephyr-projects/zephyrproject/deps/zephyr/soc/egis/Kconfig"
osource "E:/zephyr-projects/zephyr-projects/zephyrproject/deps/zephyr/soc/efinix/sapphire/Kconfig"
osource "E:/zephyr-projects/zephyr-projects/zephyrproject/deps/zephyr/soc/cdns/xtensa_sample_controller/Kconfig"
osource "E:/zephyr-projects/zephyr-projects/zephyrproject/deps/zephyr/soc/cdns/swerv/Kconfig"
osource "E:/zephyr-projects/zephyr-projects/zephyrproject/deps/zephyr/soc/cdns/sample_controller32/Kconfig"
osource "E:/zephyr-projects/zephyr-projects/zephyrproject/deps/zephyr/soc/cdns/dc233c/Kconfig"
osource "E:/zephyr-projects/zephyr-projects/zephyrproject/deps/zephyr/soc/brcm/bcmvk/Kconfig"
osource "E:/zephyr-projects/zephyr-projects/zephyrproject/deps/zephyr/soc/brcm/bcm2712/Kconfig"
osource "E:/zephyr-projects/zephyr-projects/zephyrproject/deps/zephyr/soc/brcm/bcm2711/Kconfig"
osource "E:/zephyr-projects/zephyr-projects/zephyrproject/deps/zephyr/soc/blackberry/qnxhv_vm/Kconfig"
osource "E:/zephyr-projects/zephyr-projects/zephyrproject/deps/zephyr/soc/bflb/Kconfig"
osource "E:/zephyr-projects/zephyr-projects/zephyrproject/deps/zephyr/soc/atmel/sam0/Kconfig"
osource "E:/zephyr-projects/zephyr-projects/zephyrproject/deps/zephyr/soc/atmel/sam/Kconfig"
osource "E:/zephyr-projects/zephyr-projects/zephyrproject/deps/zephyr/soc/aspeed/Kconfig"
osource "E:/zephyr-projects/zephyr-projects/zephyrproject/deps/zephyr/soc/arm/Kconfig"
osource "E:/zephyr-projects/zephyr-projects/zephyrproject/deps/zephyr/soc/arm/beetle/Kconfig"
osource "E:/zephyr-projects/zephyr-projects/zephyrproject/deps/zephyr/soc/antmicro/myra/Kconfig"
osource "E:/zephyr-projects/zephyr-projects/zephyrproject/deps/zephyr/soc/andestech/Kconfig"
osource "E:/zephyr-projects/zephyr-projects/zephyrproject/deps/zephyr/soc/amd/acp_6_0/Kconfig"
osource "E:/zephyr-projects/zephyr-projects/zephyrproject/deps/zephyr/soc/ambiq/Kconfig"
osource "E:/zephyr-projects/zephyr-projects/zephyrproject/deps/zephyr/soc/allwinner/sun8i_h3/Kconfig"
osource "E:/zephyr-projects/zephyr-projects/zephyrproject/deps/zephyr/soc/alif/ensemble/Kconfig"
osource "E:/zephyr-projects/zephyr-projects/zephyrproject/deps/zephyr/soc/aesc/Kconfig"
osource "E:/zephyr-projects/zephyr-projects/zephyrproject/deps/zephyr/soc/adi/max32/Kconfig"
```
